#include <stdint.h>
#include <stddef.h>
#include "spi_lcd.h"

// DEFINES
#define POPE_COLOR 			0xFC
#define POPE_COLOR_ALT 		0x03

static uint8_t test_text[24][32] = 
{
	{0, 0, 0, 0, 0, 0, 0, 0, 0, 0, 0, 0, 0, 0, 0, 0, 0, 0, 0, 0, 0, 0, 0, 0, 0, 0, 0, 0, 0, 0, 0, 0},
	{0, 0, 0, 0, 0, 0, 0, 0, 0, 0, 0, 0, 0, 0, 0, 0, 0, 0, 0, 0, 0, 0, 0, 0, 0, 0, 0, 0, 0, 0, 0, 0},
	{0, 0, 0, 0, 0, 0, 0, 0, 0, 0, 0, 0, 0, 0, 0, 0, 0, 0, 0, 0, 0, 0, 0, 0, 0, 0, 0, 0, 0, 0, 0, 0},
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	{0, 0, 0, 0, 0, 0, 0, 0, 0, 0, 0, 0, 0, 0, 0, 0, 0, 0, 0, 0, 0, 0, 0, 0, 0, 0, 0, 0, 0, 0, 0, 0},
};


static uint8_t disp[240][320];






void updateTestScreen(void)
{
	static uint8_t color = POPE_COLOR;
	for (size_t row = 0; row < 240; ++row)
	{
		for (size_t col = 0; col < 320; ++col)
		{
			if (test_text[row/10][col/10])
			{
				disp[row][col] = color;
			}
		}
	}
	if (color == POPE_COLOR)
	{
		color = POPE_COLOR_ALT;
	}
	else
	{
		color = POPE_COLOR;
	}
}

void lcdTestTask(void *pvParameters)
{
	while (1)
	{
		static uint8_t counter;
		spi_lcd_wait_finish();
		spi_lcd_send(disp);
		if (!(counter++))
		{
			updateTestScreen();
		}
		if (counter>=32)
		{
			counter = 0;
		}
	}
}


